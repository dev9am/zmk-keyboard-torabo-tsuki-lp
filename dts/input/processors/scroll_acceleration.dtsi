/*
 * Copyright (c) 2025
 * SPDX-License-Identifier: MIT
 */

#include <zephyr/dt-bindings/input/input-event-codes.h>

/ {
    /omit-if-no-ref/ zip_scroll_acceleration: zip_scroll_acceleration {
        compatible = "zmk,input-processor-scroll-acceleration";
        #input-processor-cells = <2>;
        type = <INPUT_EV_REL>;
        codes = <INPUT_REL_X INPUT_REL_Y>;
    };
};
